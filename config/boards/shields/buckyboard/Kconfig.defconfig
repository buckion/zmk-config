## config/boards/shields/buckyboard/Kconfig.defconfig
```kconfig
if SHIELD_BUCKYBOARD_LEFT

config ZMK_KEYBOARD_NAME
    default "Buckyboard"

config ZMK_SPLIT_ROLE_CENTRAL
    default y

endif

if SHIELD_BUCKYBOARD_LEFT || SHIELD_BUCKYBOARD_RIGHT

config ZMK_SPLIT
    default y

endif
```

## config/boards/shields/buckyboard/Kconfig.shield
```kconfig
config SHIELD_BUCKYBOARD_LEFT
  def_bool $(shields_list_contains,buckyboard_left)

config SHIELD_BUCKYBOARD_RIGHT
  def_bool $(shields_list_contains,buckyboard_right)
```
